## esp32/main/Kconfig.projbuild
```kconfig
menu "Button Configuration"

    orsource "$IDF_PATH/examples/common_components/env_caps/$IDF_TARGET/Kconfig.env_caps"

    config LED_GPIO
        int "Blink GPIO number"
        range ENV_GPIO_RANGE_MIN ENV_GPIO_OUT_RANGE_MAX
        default 18
        help
            GPIO number (IOxx) to blink on and off for the addressable LED.
            Some GPIOs are used for other purposes (flash connections, etc.) and cannot be used to blink.

    config BUTTON_GPIO
        int "Button GPIO number"
        range ENV_GPIO_RANGE_MIN ENV_GPIO_OUT_RANGE_MAX
        default 21
        help
            GPIO number (IOxx) to which the button is attached.
            Some GPIOs are used for other purposes (flash connections, etc.) and cannot be used to blink.

    config BUTTON_DEBOUNCE_TIME
        int "Debounce time in ms"
        range 10 3600000
        default 1000
        help
            Define the debounce period in milliseconds.

endmenu
```
